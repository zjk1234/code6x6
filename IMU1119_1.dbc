VERSION ""

NS_ :

BS_:

BU_: IMU_GPS

BO_ 263 IMU8: 8 IMU_GPS
 SG_ Pitching : 0|32@1- (1,0) [0|0] "" Vector__XXX

BO_ 262 IMU7: 8 IMU_GPS
 SG_ Heading : 32|32@1- (1,0) [0|0] "" Vector__XXX
 SG_ Rolling : 0|32@1- (1,0) [0|0] "" Vector__XXX

BO_ 261 IMU6: 8 IMU_GPS
 SG_ Latitude : 32|32@1+ (1E-007,0) [0|0] "" Vector__XXX
 SG_ Longitude : 0|32@1+ (1E-007,0) [0|0] "" Vector__XXX

BO_ 260 IMU5: 8 IMU_GPS
 SG_ Altitude : 32|32@1- (1,0) [0|0] "" Vector__XXX
 SG_ EastSpd : 0|32@1- (1,0) [0|0] "" Vector__XXX

BO_ 259 IMU4: 8 IMU_GPS
 SG_ SkySpd : 32|32@1- (1,0) [0|0] "" Vector__XXX
 SG_ NorthSpd : 0|32@1- (1,0) [0|0] "" Vector__XXX

BO_ 257 IMU2: 8 IMU_GPS
 SG_ Xacceleration : 32|32@1- (1,0) [0|0] "" Vector__XXX
 SG_ Zangularrate : 0|32@1- (1,0) [0|0] "" Vector__XXX

BO_ 256 IMU1: 8 IMU_GPS
 SG_ Yangularrate : 32|32@1- (1,0) [0|0] "" Vector__XXX
 SG_ Xangularrate : 0|32@1- (1,0) [0|0] "" Vector__XXX

BO_ 258 IMU3: 8 IMU_GPS
 SG_ Zacceleration : 32|32@1- (1,0) [0|0] "" Vector__XXX
 SG_ Yacceleration : 0|32@1- (1,0) [0|0] "" Vector__XXX

EV_ EnvKlemme15: 0 [0|1] "" 0 1 DUMMY_NODE_VECTOR0 Vector__XXX;

BA_DEF_ BO_  "GenMsgILSupport" ENUM  "No","Yes";
BA_DEF_  "NmBaseAddress" HEX 1024 1087;
BA_DEF_  "BusType" STRING ;
BA_DEF_ BO_  "GenMsgSendType" ENUM  "Cyclic","NotUsed","NotUsed","NotUsed","NotUsed","Cyclic","NotUsed","IfActive","NoMsgSendType","NotUsed","vector_leerstring";
BA_DEF_ SG_  "GenSigSendType" ENUM  "Cyclic","OnWrite","OnWriteWithRepetition","OnChange","OnChangeWithRepetition","IfActive","IfActiveWithRepetition","NoSigSendType","NotUsed","NotUsed","NotUsed","NotUsed","NotUsed";
BA_DEF_DEF_  "GenMsgILSupport" "Yes";
BA_DEF_DEF_  "NmBaseAddress" 1024;
BA_DEF_DEF_  "BusType" "CAN";
BA_DEF_DEF_  "GenMsgSendType" "NoMsgSendType";
BA_DEF_DEF_  "GenSigSendType" "Cyclic";
SIG_VALTYPE_ 263 Pitching : 1;
SIG_VALTYPE_ 262 Heading : 1;
SIG_VALTYPE_ 262 Rolling : 1;
SIG_VALTYPE_ 260 Altitude : 1;
SIG_VALTYPE_ 260 EastSpd : 1;
SIG_VALTYPE_ 259 SkySpd : 1;
SIG_VALTYPE_ 259 NorthSpd : 1;
SIG_VALTYPE_ 257 Xacceleration : 1;
SIG_VALTYPE_ 257 Zangularrate : 1;
SIG_VALTYPE_ 256 Yangularrate : 1;
SIG_VALTYPE_ 256 Xangularrate : 1;
SIG_VALTYPE_ 258 Zacceleration : 1;
SIG_VALTYPE_ 258 Yacceleration : 1;

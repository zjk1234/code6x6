/******************************************************************************
* ASAP2 file: six_plus_six_AcmsteeringV09_main_2lfrf.a2l
* Code generation for model "six_plus_six_AcmsteeringV09_main_2lfrf".
* Model version : 1.2720
* Simulink Coder version : 8.6 (R2014a) 27-Dec-2013
* C source code generated on : Mon Nov 23 16:45:24 2020
* Target selection: ec5744.tlc
* Embedded hardware selection: Freescale MPC5500
* Code generation objectives: Unspecified
* Validation result: Not run
* (add additional file header information here)
******************************************************************************/ ASAP2_VERSION 1 31
/* Version 1.31 */
/begin PROJECT ECUCoderProject "ECUCoder Project"
/begin HEADER "Header Comments go here" /end HEADER
/begin MODULE ModuleName "Module Comment Goes Here"
/begin MOD_PAR "MOD PAR Comment Goes Here" /end MOD_PAR
/begin MOD_COMMON "Mod Common Comment Here" BYTE_ORDER MSB_FIRST /end MOD_COMMON
/begin RECORD_LAYOUT Scalar_BOOLEAN FNC_VALUES 1 UBYTE COLUMN_DIR DIRECT /end RECORD_LAYOUT
/begin RECORD_LAYOUT Scalar_UBYTE FNC_VALUES 1 UBYTE COLUMN_DIR DIRECT /end RECORD_LAYOUT
/begin RECORD_LAYOUT Scalar_BYTE FNC_VALUES 1 SBYTE COLUMN_DIR DIRECT /end RECORD_LAYOUT
/begin RECORD_LAYOUT Scalar_UWORD FNC_VALUES 1 UWORD COLUMN_DIR DIRECT /end RECORD_LAYOUT
/begin RECORD_LAYOUT Scalar_SWORD FNC_VALUES 1 SWORD COLUMN_DIR DIRECT /end RECORD_LAYOUT
/begin RECORD_LAYOUT Scalar_ULONG FNC_VALUES 1 ULONG COLUMN_DIR DIRECT /end RECORD_LAYOUT
/begin RECORD_LAYOUT Scalar_LONG FNC_VALUES 1 SLONG COLUMN_DIR DIRECT /end RECORD_LAYOUT
/begin RECORD_LAYOUT Scalar_FLOAT32_IEEE FNC_VALUES 1 FLOAT32_IEEE COLUMN_DIR DIRECT /end RECORD_LAYOUT
/begin RECORD_LAYOUT Scalar_FLOAT64_IEEE FNC_VALUES 1 FLOAT64_IEEE COLUMN_DIR DIRECT /end RECORD_LAYOUT
/begin RECORD_LAYOUT Lookup1D_BOOLEAN FNC_VALUES 1 UBYTE COLUMN_DIR DIRECT /end RECORD_LAYOUT
/begin RECORD_LAYOUT Lookup1D_X_BOOLEAN AXIS_PTS_X 1 UBYTE INDEX_INCR DIRECT /end RECORD_LAYOUT
/begin RECORD_LAYOUT Lookup1D_BYTE FNC_VALUES 1 SBYTE COLUMN_DIR DIRECT /end RECORD_LAYOUT
/begin RECORD_LAYOUT Lookup1D_X_BYTE AXIS_PTS_X 1 SBYTE INDEX_INCR DIRECT /end RECORD_LAYOUT
/begin RECORD_LAYOUT Lookup1D_UBYTE FNC_VALUES 1 UBYTE COLUMN_DIR DIRECT /end RECORD_LAYOUT
/begin RECORD_LAYOUT Lookup1D_X_UBYTE AXIS_PTS_X 1 UBYTE INDEX_INCR DIRECT /end RECORD_LAYOUT
/begin RECORD_LAYOUT Lookup1D_UWORD FNC_VALUES 1 UWORD COLUMN_DIR DIRECT /end RECORD_LAYOUT
/begin RECORD_LAYOUT Lookup1D_X_UWORD AXIS_PTS_X 1 UWORD INDEX_INCR DIRECT /end RECORD_LAYOUT
/begin RECORD_LAYOUT Lookup1D_WORD FNC_VALUES 1 SWORD COLUMN_DIR DIRECT /end RECORD_LAYOUT
/begin RECORD_LAYOUT Lookup1D_X_WORD AXIS_PTS_X 1 SWORD INDEX_INCR DIRECT /end RECORD_LAYOUT
/begin RECORD_LAYOUT Lookup1D_ULONG FNC_VALUES 1 ULONG COLUMN_DIR DIRECT /end RECORD_LAYOUT
/begin RECORD_LAYOUT Lookup1D_X_ULONG AXIS_PTS_X 1 ULONG INDEX_INCR DIRECT /end RECORD_LAYOUT
/begin RECORD_LAYOUT Lookup1D_SLONG FNC_VALUES 1 SLONG COLUMN_DIR DIRECT /end RECORD_LAYOUT
/begin RECORD_LAYOUT Lookup1D_X_LONG AXIS_PTS_X 1 SLONG INDEX_INCR DIRECT /end RECORD_LAYOUT
/begin RECORD_LAYOUT Lookup1D_FLOAT32_IEEE FNC_VALUES 1 FLOAT32_IEEE COLUMN_DIR DIRECT /end RECORD_LAYOUT
/begin RECORD_LAYOUT Lookup1D_X_FLOAT32_IEEE AXIS_PTS_X 1 FLOAT32_IEEE INDEX_INCR DIRECT /end RECORD_LAYOUT
/begin RECORD_LAYOUT Lookup1D_FLOAT64_IEEE FNC_VALUES 1 FLOAT64_IEEE COLUMN_DIR DIRECT /end RECORD_LAYOUT
/begin RECORD_LAYOUT Lookup1D_X_FLOAT64_IEEE AXIS_PTS_X 1 FLOAT64_IEEE INDEX_INCR DIRECT /end RECORD_LAYOUT
/begin RECORD_LAYOUT Lookup2D_BOOLEAN FNC_VALUES 1 UBYTE COLUMN_DIR DIRECT /end RECORD_LAYOUT
/begin RECORD_LAYOUT Lookup2D_X_BOOLEAN AXIS_PTS_X 1 UBYTE INDEX_INCR DIRECT /end RECORD_LAYOUT
/begin RECORD_LAYOUT Lookup2D_UBYTE FNC_VALUES 1 UBYTE COLUMN_DIR DIRECT /end RECORD_LAYOUT
/begin RECORD_LAYOUT Lookup2D_X_UBYTE AXIS_PTS_X 1 UBYTE INDEX_INCR DIRECT /end RECORD_LAYOUT
/begin RECORD_LAYOUT Lookup2D_BYTE FNC_VALUES 1 SBYTE COLUMN_DIR DIRECT /end RECORD_LAYOUT
/begin RECORD_LAYOUT Lookup2D_X_BYTE AXIS_PTS_X 1 SBYTE INDEX_INCR DIRECT /end RECORD_LAYOUT
/begin RECORD_LAYOUT Lookup2D_UWORD FNC_VALUES 1 UWORD COLUMN_DIR DIRECT /end RECORD_LAYOUT
/begin RECORD_LAYOUT Lookup2D_X_UWORD AXIS_PTS_X 1 UWORD INDEX_INCR DIRECT /end RECORD_LAYOUT
/begin RECORD_LAYOUT Lookup2D_WORD FNC_VALUES 1 SWORD COLUMN_DIR DIRECT /end RECORD_LAYOUT
/begin RECORD_LAYOUT Lookup2D_X_WORD AXIS_PTS_X 1 SWORD INDEX_INCR DIRECT /end RECORD_LAYOUT
/begin RECORD_LAYOUT Lookup2D_ULONG FNC_VALUES 1 ULONG COLUMN_DIR DIRECT /end RECORD_LAYOUT
/begin RECORD_LAYOUT Lookup2D_X_ULONG AXIS_PTS_X 1 ULONG INDEX_INCR DIRECT /end RECORD_LAYOUT
/begin RECORD_LAYOUT Lookup2D_LONG FNC_VALUES 1 SLONG COLUMN_DIR DIRECT /end RECORD_LAYOUT
/begin RECORD_LAYOUT Lookup2D_X_LONG AXIS_PTS_X 1 SLONG INDEX_INCR DIRECT /end RECORD_LAYOUT
/begin RECORD_LAYOUT Lookup2D_FLOAT32_IEEE FNC_VALUES 1 FLOAT32_IEEE COLUMN_DIR DIRECT /end RECORD_LAYOUT
/begin RECORD_LAYOUT Lookup2D_X_FLOAT32_IEEE AXIS_PTS_X 1 FLOAT32_IEEE INDEX_INCR DIRECT /end RECORD_LAYOUT
/begin RECORD_LAYOUT Lookup2D_FLOAT64_IEEE FNC_VALUES 1 FLOAT64_IEEE COLUMN_DIR DIRECT /end RECORD_LAYOUT
/begin RECORD_LAYOUT Lookup2D_X_FLOAT64_IEEE AXIS_PTS_X 1 FLOAT64_IEEE INDEX_INCR DIRECT /end RECORD_LAYOUT
/begin CHARACTERISTIC guzhang_lm "" VALUE @MemoryAddress@guzhang_lm@ Scalar_FLOAT64_IEEE 0 six_plus_six_AcmsteeringV09_main_2lfrf_CM_double -1.7E+308 1.7E+308 /end CHARACTERISTIC
/begin CHARACTERISTIC guzhang_lr "" VALUE @MemoryAddress@guzhang_lr@ Scalar_FLOAT64_IEEE 0 six_plus_six_AcmsteeringV09_main_2lfrf_CM_double -1.7E+308 1.7E+308 /end CHARACTERISTIC
/begin CHARACTERISTIC guzhang_rm "" VALUE @MemoryAddress@guzhang_rm@ Scalar_FLOAT64_IEEE 0 six_plus_six_AcmsteeringV09_main_2lfrf_CM_double -1.7E+308 1.7E+308 /end CHARACTERISTIC
/begin CHARACTERISTIC guzhang_rr "" VALUE @MemoryAddress@guzhang_rr@ Scalar_FLOAT64_IEEE 0 six_plus_six_AcmsteeringV09_main_2lfrf_CM_double -1.7E+308 1.7E+308 /end CHARACTERISTIC
/begin CHARACTERISTIC kd1 "" VALUE @MemoryAddress@kd1@ Scalar_FLOAT64_IEEE 0 six_plus_six_AcmsteeringV09_main_2lfrf_CM_double -1.7E+308 1.7E+308 /end CHARACTERISTIC
/begin CHARACTERISTIC ki1 "" VALUE @MemoryAddress@ki1@ Scalar_FLOAT64_IEEE 0 six_plus_six_AcmsteeringV09_main_2lfrf_CM_double -1.7E+308 1.7E+308 /end CHARACTERISTIC
/begin CHARACTERISTIC kp1 "" VALUE @MemoryAddress@kp1@ Scalar_FLOAT64_IEEE 0 six_plus_six_AcmsteeringV09_main_2lfrf_CM_double -1.7E+308 1.7E+308 /end CHARACTERISTIC
/begin CHARACTERISTIC ESP_switch "" VALUE @MemoryAddress@ESP_switch@ Scalar_FLOAT32_IEEE 0 six_plus_six_AcmsteeringV09_main_2lfrf_CM_single -3.4E+38 3.4E+38 /end CHARACTERISTIC
/begin CHARACTERISTIC TCS_switch "" VALUE @MemoryAddress@TCS_switch@ Scalar_FLOAT32_IEEE 0 six_plus_six_AcmsteeringV09_main_2lfrf_CM_single -3.4E+38 3.4E+38 /end CHARACTERISTIC
/begin CHARACTERISTIC ag_thr "" VALUE @MemoryAddress@ag_thr@ Scalar_FLOAT32_IEEE 0 six_plus_six_AcmsteeringV09_main_2lfrf_CM_single -3.4E+38 3.4E+38 /end CHARACTERISTIC
/begin MEASUREMENT BMS1_1SOC "" FLOAT64_IEEE six_plus_six_AcmsteeringV09_main_2lfrf_CM_double 0 0 -1.7E+308 1.7E+308 ECU_ADDRESS @MemoryAddress@BMS1_1SOC@ /end MEASUREMENT
/begin MEASUREMENT Pitching "" FLOAT64_IEEE six_plus_six_AcmsteeringV09_main_2lfrf_CM_double 0 0 -1.7E+308 1.7E+308 ECU_ADDRESS @MemoryAddress@Pitching@ /end MEASUREMENT
/begin MEASUREMENT Rolling "" FLOAT64_IEEE six_plus_six_AcmsteeringV09_main_2lfrf_CM_double 0 0 -1.7E+308 1.7E+308 ECU_ADDRESS @MemoryAddress@Rolling@ /end MEASUREMENT
/begin MEASUREMENT Heading "" FLOAT64_IEEE six_plus_six_AcmsteeringV09_main_2lfrf_CM_double 0 0 -1.7E+308 1.7E+308 ECU_ADDRESS @MemoryAddress@Heading@ /end MEASUREMENT
/begin MEASUREMENT Longitude "" FLOAT64_IEEE six_plus_six_AcmsteeringV09_main_2lfrf_CM_double 0 0 -1.7E+308 1.7E+308 ECU_ADDRESS @MemoryAddress@Longitude@ /end MEASUREMENT
/begin MEASUREMENT Latitude "" FLOAT64_IEEE six_plus_six_AcmsteeringV09_main_2lfrf_CM_double 0 0 -1.7E+308 1.7E+308 ECU_ADDRESS @MemoryAddress@Latitude@ /end MEASUREMENT
/begin MEASUREMENT EastSpd "" FLOAT64_IEEE six_plus_six_AcmsteeringV09_main_2lfrf_CM_double 0 0 -1.7E+308 1.7E+308 ECU_ADDRESS @MemoryAddress@EastSpd@ /end MEASUREMENT
/begin MEASUREMENT Altitude "" FLOAT64_IEEE six_plus_six_AcmsteeringV09_main_2lfrf_CM_double 0 0 -1.7E+308 1.7E+308 ECU_ADDRESS @MemoryAddress@Altitude@ /end MEASUREMENT
/begin MEASUREMENT NorthSpd "" FLOAT64_IEEE six_plus_six_AcmsteeringV09_main_2lfrf_CM_double 0 0 -1.7E+308 1.7E+308 ECU_ADDRESS @MemoryAddress@NorthSpd@ /end MEASUREMENT
/begin MEASUREMENT SkySpd "" FLOAT64_IEEE six_plus_six_AcmsteeringV09_main_2lfrf_CM_double 0 0 -1.7E+308 1.7E+308 ECU_ADDRESS @MemoryAddress@SkySpd@ /end MEASUREMENT
/begin MEASUREMENT Yacceleration "" FLOAT64_IEEE six_plus_six_AcmsteeringV09_main_2lfrf_CM_double 0 0 -1.7E+308 1.7E+308 ECU_ADDRESS @MemoryAddress@Yacceleration@ /end MEASUREMENT
/begin MEASUREMENT Zacceleration "" FLOAT64_IEEE six_plus_six_AcmsteeringV09_main_2lfrf_CM_double 0 0 -1.7E+308 1.7E+308 ECU_ADDRESS @MemoryAddress@Zacceleration@ /end MEASUREMENT
/begin MEASUREMENT Zangularrate "" FLOAT64_IEEE six_plus_six_AcmsteeringV09_main_2lfrf_CM_double 0 0 -1.7E+308 1.7E+308 ECU_ADDRESS @MemoryAddress@Zangularrate@ /end MEASUREMENT
/begin MEASUREMENT Xacceleration "" FLOAT64_IEEE six_plus_six_AcmsteeringV09_main_2lfrf_CM_double 0 0 -1.7E+308 1.7E+308 ECU_ADDRESS @MemoryAddress@Xacceleration@ /end MEASUREMENT
/begin MEASUREMENT Xangularrate "" FLOAT64_IEEE six_plus_six_AcmsteeringV09_main_2lfrf_CM_double 0 0 -1.7E+308 1.7E+308 ECU_ADDRESS @MemoryAddress@Xangularrate@ /end MEASUREMENT
/begin MEASUREMENT Yangularrate "" FLOAT64_IEEE six_plus_six_AcmsteeringV09_main_2lfrf_CM_double 0 0 -1.7E+308 1.7E+308 ECU_ADDRESS @MemoryAddress@Yangularrate@ /end MEASUREMENT
/begin MEASUREMENT MCU0_5SpeedFdk "" FLOAT64_IEEE six_plus_six_AcmsteeringV09_main_2lfrf_CM_double 0 0 -1.7E+308 1.7E+308 ECU_ADDRESS @MemoryAddress@MCU0_5SpeedFdk@ /end MEASUREMENT
/begin MEASUREMENT BMS1_SOC "" FLOAT64_IEEE six_plus_six_AcmsteeringV09_main_2lfrf_CM_double 0 0 -1.7E+308 1.7E+308 ECU_ADDRESS @MemoryAddress@BMS1_SOC@ /end MEASUREMENT
/begin MEASUREMENT MCU0_4SpeedFdk "" FLOAT64_IEEE six_plus_six_AcmsteeringV09_main_2lfrf_CM_double 0 0 -1.7E+308 1.7E+308 ECU_ADDRESS @MemoryAddress@MCU0_4SpeedFdk@ /end MEASUREMENT
/begin MEASUREMENT MCU0_3SpeedFdk "" FLOAT64_IEEE six_plus_six_AcmsteeringV09_main_2lfrf_CM_double 0 0 -1.7E+308 1.7E+308 ECU_ADDRESS @MemoryAddress@MCU0_3SpeedFdk@ /end MEASUREMENT
/begin MEASUREMENT MCU0_2SpeedFdk "" FLOAT64_IEEE six_plus_six_AcmsteeringV09_main_2lfrf_CM_double 0 0 -1.7E+308 1.7E+308 ECU_ADDRESS @MemoryAddress@MCU0_2SpeedFdk@ /end MEASUREMENT
/begin MEASUREMENT MCU0_1SpeedFdk "" FLOAT64_IEEE six_plus_six_AcmsteeringV09_main_2lfrf_CM_double 0 0 -1.7E+308 1.7E+308 ECU_ADDRESS @MemoryAddress@MCU0_1SpeedFdk@ /end MEASUREMENT
/begin MEASUREMENT BMS1_2SOC "" FLOAT64_IEEE six_plus_six_AcmsteeringV09_main_2lfrf_CM_double 0 0 -1.7E+308 1.7E+308 ECU_ADDRESS @MemoryAddress@BMS1_2SOC@ /end MEASUREMENT
/begin MEASUREMENT MCU0_SpeedFdk "" FLOAT64_IEEE six_plus_six_AcmsteeringV09_main_2lfrf_CM_double 0 0 -1.7E+308 1.7E+308 ECU_ADDRESS @MemoryAddress@MCU0_SpeedFdk@ /end MEASUREMENT
/begin MEASUREMENT acc_y "" FLOAT64_IEEE six_plus_six_AcmsteeringV09_main_2lfrf_CM_double 0 0 -1.7E+308 1.7E+308 ECU_ADDRESS @MemoryAddress@acc_y@ /end MEASUREMENT
/begin MEASUREMENT s_act_lf "" FLOAT32_IEEE six_plus_six_AcmsteeringV09_main_2lfrf_CM_single 0 0 -3.4E+38 3.4E+38 ECU_ADDRESS @MemoryAddress@s_act_lf@ /end MEASUREMENT
/begin MEASUREMENT s_act_lm "" FLOAT32_IEEE six_plus_six_AcmsteeringV09_main_2lfrf_CM_single 0 0 -3.4E+38 3.4E+38 ECU_ADDRESS @MemoryAddress@s_act_lm@ /end MEASUREMENT
/begin MEASUREMENT s_act_lr "" FLOAT32_IEEE six_plus_six_AcmsteeringV09_main_2lfrf_CM_single 0 0 -3.4E+38 3.4E+38 ECU_ADDRESS @MemoryAddress@s_act_lr@ /end MEASUREMENT
/begin MEASUREMENT s_act_rf "" FLOAT32_IEEE six_plus_six_AcmsteeringV09_main_2lfrf_CM_single 0 0 -3.4E+38 3.4E+38 ECU_ADDRESS @MemoryAddress@s_act_rf@ /end MEASUREMENT
/begin MEASUREMENT s_act_rm "" FLOAT32_IEEE six_plus_six_AcmsteeringV09_main_2lfrf_CM_single 0 0 -3.4E+38 3.4E+38 ECU_ADDRESS @MemoryAddress@s_act_rm@ /end MEASUREMENT
/begin MEASUREMENT s_act_rr "" FLOAT32_IEEE six_plus_six_AcmsteeringV09_main_2lfrf_CM_single 0 0 -3.4E+38 3.4E+38 ECU_ADDRESS @MemoryAddress@s_act_rr@ /end MEASUREMENT
/begin MEASUREMENT trq_out_l_forward "" FLOAT32_IEEE six_plus_six_AcmsteeringV09_main_2lfrf_CM_single 0 0 -3.4E+38 3.4E+38 ECU_ADDRESS @MemoryAddress@trq_out_l_forward@ /end MEASUREMENT
/begin MEASUREMENT trq_out_r_forward "" FLOAT32_IEEE six_plus_six_AcmsteeringV09_main_2lfrf_CM_single 0 0 -3.4E+38 3.4E+38 ECU_ADDRESS @MemoryAddress@trq_out_r_forward@ /end MEASUREMENT
/begin MEASUREMENT trq_dem_l_forward "" FLOAT32_IEEE six_plus_six_AcmsteeringV09_main_2lfrf_CM_single 0 0 -3.4E+38 3.4E+38 ECU_ADDRESS @MemoryAddress@trq_dem_l_forward@ /end MEASUREMENT
/begin MEASUREMENT trq_dem_r_forward "" FLOAT32_IEEE six_plus_six_AcmsteeringV09_main_2lfrf_CM_single 0 0 -3.4E+38 3.4E+38 ECU_ADDRESS @MemoryAddress@trq_dem_r_forward@ /end MEASUREMENT
/begin MEASUREMENT trq_adjust_l_forward "" FLOAT32_IEEE six_plus_six_AcmsteeringV09_main_2lfrf_CM_single 0 0 -3.4E+38 3.4E+38 ECU_ADDRESS @MemoryAddress@trq_adjust_l_forward@ /end MEASUREMENT
/begin MEASUREMENT trq_adjust_r_forward "" FLOAT32_IEEE six_plus_six_AcmsteeringV09_main_2lfrf_CM_single 0 0 -3.4E+38 3.4E+38 ECU_ADDRESS @MemoryAddress@trq_adjust_r_forward@ /end MEASUREMENT
/begin MEASUREMENT trq_pid_rm_adjust "" FLOAT32_IEEE six_plus_six_AcmsteeringV09_main_2lfrf_CM_single 0 0 -3.4E+38 3.4E+38 ECU_ADDRESS @MemoryAddress@trq_pid_rm_adjust@ /end MEASUREMENT
/begin MEASUREMENT trq_pid_lm_adjust "" FLOAT32_IEEE six_plus_six_AcmsteeringV09_main_2lfrf_CM_single 0 0 -3.4E+38 3.4E+38 ECU_ADDRESS @MemoryAddress@trq_pid_lm_adjust@ /end MEASUREMENT
/begin MEASUREMENT trq_pid_rr_adjust "" FLOAT32_IEEE six_plus_six_AcmsteeringV09_main_2lfrf_CM_single 0 0 -3.4E+38 3.4E+38 ECU_ADDRESS @MemoryAddress@trq_pid_rr_adjust@ /end MEASUREMENT
/begin MEASUREMENT trq_pid_rf_adjust "" FLOAT32_IEEE six_plus_six_AcmsteeringV09_main_2lfrf_CM_single 0 0 -3.4E+38 3.4E+38 ECU_ADDRESS @MemoryAddress@trq_pid_rf_adjust@ /end MEASUREMENT
/begin MEASUREMENT trq_pid_lr_adjust "" FLOAT32_IEEE six_plus_six_AcmsteeringV09_main_2lfrf_CM_single 0 0 -3.4E+38 3.4E+38 ECU_ADDRESS @MemoryAddress@trq_pid_lr_adjust@ /end MEASUREMENT
/begin MEASUREMENT trq_pid_lf_adjust "" FLOAT32_IEEE six_plus_six_AcmsteeringV09_main_2lfrf_CM_single 0 0 -3.4E+38 3.4E+38 ECU_ADDRESS @MemoryAddress@trq_pid_lf_adjust@ /end MEASUREMENT
/begin MEASUREMENT trq_out_lf_forward "" FLOAT32_IEEE six_plus_six_AcmsteeringV09_main_2lfrf_CM_single 0 0 -3.4E+38 3.4E+38 ECU_ADDRESS @MemoryAddress@trq_out_lf_forward@ /end MEASUREMENT
/begin MEASUREMENT trq_out_lm_forward "" FLOAT32_IEEE six_plus_six_AcmsteeringV09_main_2lfrf_CM_single 0 0 -3.4E+38 3.4E+38 ECU_ADDRESS @MemoryAddress@trq_out_lm_forward@ /end MEASUREMENT
/begin MEASUREMENT trq_out_lr_forward "" FLOAT32_IEEE six_plus_six_AcmsteeringV09_main_2lfrf_CM_single 0 0 -3.4E+38 3.4E+38 ECU_ADDRESS @MemoryAddress@trq_out_lr_forward@ /end MEASUREMENT
/begin MEASUREMENT trq_out_rf_forward "" FLOAT32_IEEE six_plus_six_AcmsteeringV09_main_2lfrf_CM_single 0 0 -3.4E+38 3.4E+38 ECU_ADDRESS @MemoryAddress@trq_out_rf_forward@ /end MEASUREMENT
/begin MEASUREMENT trq_out_rm_forward "" FLOAT32_IEEE six_plus_six_AcmsteeringV09_main_2lfrf_CM_single 0 0 -3.4E+38 3.4E+38 ECU_ADDRESS @MemoryAddress@trq_out_rm_forward@ /end MEASUREMENT
/begin MEASUREMENT trq_out_rr_forward "" FLOAT32_IEEE six_plus_six_AcmsteeringV09_main_2lfrf_CM_single 0 0 -3.4E+38 3.4E+38 ECU_ADDRESS @MemoryAddress@trq_out_rr_forward@ /end MEASUREMENT
/begin MEASUREMENT flag_lf "" FLOAT32_IEEE six_plus_six_AcmsteeringV09_main_2lfrf_CM_single 0 0 -3.4E+38 3.4E+38 ECU_ADDRESS @MemoryAddress@flag_lf@ /end MEASUREMENT
/begin MEASUREMENT flag_lm "" FLOAT32_IEEE six_plus_six_AcmsteeringV09_main_2lfrf_CM_single 0 0 -3.4E+38 3.4E+38 ECU_ADDRESS @MemoryAddress@flag_lm@ /end MEASUREMENT
/begin MEASUREMENT flag_lr "" FLOAT32_IEEE six_plus_six_AcmsteeringV09_main_2lfrf_CM_single 0 0 -3.4E+38 3.4E+38 ECU_ADDRESS @MemoryAddress@flag_lr@ /end MEASUREMENT
/begin MEASUREMENT flag_rf "" FLOAT32_IEEE six_plus_six_AcmsteeringV09_main_2lfrf_CM_single 0 0 -3.4E+38 3.4E+38 ECU_ADDRESS @MemoryAddress@flag_rf@ /end MEASUREMENT
/begin MEASUREMENT flag_rm "" FLOAT32_IEEE six_plus_six_AcmsteeringV09_main_2lfrf_CM_single 0 0 -3.4E+38 3.4E+38 ECU_ADDRESS @MemoryAddress@flag_rm@ /end MEASUREMENT
/begin MEASUREMENT flag_rr "" FLOAT32_IEEE six_plus_six_AcmsteeringV09_main_2lfrf_CM_single 0 0 -3.4E+38 3.4E+38 ECU_ADDRESS @MemoryAddress@flag_rr@ /end MEASUREMENT
/begin MEASUREMENT delta_Twending_dem "" FLOAT32_IEEE six_plus_six_AcmsteeringV09_main_2lfrf_CM_single 0 0 -3.4E+38 3.4E+38 ECU_ADDRESS @MemoryAddress@delta_Twending_dem@ /end MEASUREMENT
/begin MEASUREMENT mode_dem_out "" SBYTE six_plus_six_AcmsteeringV09_main_2lfrf_CM_int8 0 0 -128 127 ECU_ADDRESS @MemoryAddress@mode_dem_out@ /end MEASUREMENT
/begin MEASUREMENT TCS_mode "" SBYTE six_plus_six_AcmsteeringV09_main_2lfrf_CM_int8 0 0 -128 127 ECU_ADDRESS @MemoryAddress@TCS_mode@ /end MEASUREMENT
/begin COMPU_METHOD six_plus_six_AcmsteeringV09_main_2lfrf_CM_double "Q = V" RAT_FUNC "%15.10" "" COEFFS 0 1 0 0 0 1 /end COMPU_METHOD
/begin COMPU_METHOD six_plus_six_AcmsteeringV09_main_2lfrf_CM_single "Q = V" RAT_FUNC "%8.6" "" COEFFS 0 1 0 0 0 1 /end COMPU_METHOD
/begin COMPU_METHOD six_plus_six_AcmsteeringV09_main_2lfrf_CM_int8 "Q = V" RAT_FUNC "%3.0" "" COEFFS 0 1 0 0 0 1 /end COMPU_METHOD
/begin GROUP six_plus_six_AcmsteeringV09_main_2lfrf "six_plus_six_AcmsteeringV09_main_2lfrf" /* Root */ ROOT /begin SUB_GROUP Root_Data_input Root_InputSignalProcess Root_MainControl /end SUB_GROUP /end GROUP
/begin GROUP Root_Data_input "six_plus_six_AcmsteeringV09_main_2lfrf/Data_input"
 /begin SUB_GROUP S1_10 S1_11 S1_4 S1_5 S1_6 S1_7 S1_8 S1_9 S1_BMS1 S1_BMS1_1 S1_BMS1_2 S1_MCU0 S1_MCU0_1 S1_MCU0_2 S1_MCU0_3 S1_MCU0_4 S1_MCU0_5 /end SUB_GROUP
/end GROUP
/begin GROUP Root_InputSignalProcess "six_plus_six_AcmsteeringV09_main_2lfrf/InputSignalProcess" /begin REF_MEASUREMENT acc_y /end REF_MEASUREMENT /end GROUP
/begin GROUP Root_MainControl "six_plus_six_AcmsteeringV09_main_2lfrf/MainControl" /begin SUB_GROUP S3_mode_control S3_mode_switch /end SUB_GROUP /end GROUP
/begin GROUP S1_10 "six_plus_six_AcmsteeringV09_main_2lfrf/Data_input/10" /begin REF_MEASUREMENT Heading Rolling /end REF_MEASUREMENT /end GROUP
/begin GROUP S1_11 "six_plus_six_AcmsteeringV09_main_2lfrf/Data_input/11" /begin REF_MEASUREMENT Pitching /end REF_MEASUREMENT /end GROUP
/begin GROUP S1_4 "six_plus_six_AcmsteeringV09_main_2lfrf/Data_input/4" /begin REF_MEASUREMENT Xangularrate Yangularrate /end REF_MEASUREMENT /end GROUP
/begin GROUP S1_5 "six_plus_six_AcmsteeringV09_main_2lfrf/Data_input/5" /begin REF_MEASUREMENT Xacceleration Zangularrate /end REF_MEASUREMENT /end GROUP
/begin GROUP S1_6 "six_plus_six_AcmsteeringV09_main_2lfrf/Data_input/6" /begin REF_MEASUREMENT Yacceleration Zacceleration /end REF_MEASUREMENT /end GROUP
/begin GROUP S1_7 "six_plus_six_AcmsteeringV09_main_2lfrf/Data_input/7" /begin REF_MEASUREMENT NorthSpd SkySpd /end REF_MEASUREMENT /end GROUP
/begin GROUP S1_8 "six_plus_six_AcmsteeringV09_main_2lfrf/Data_input/8" /begin REF_MEASUREMENT Altitude EastSpd /end REF_MEASUREMENT /end GROUP
/begin GROUP S1_9 "six_plus_six_AcmsteeringV09_main_2lfrf/Data_input/9" /begin REF_MEASUREMENT Latitude Longitude /end REF_MEASUREMENT /end GROUP
/begin GROUP S1_BMS1 "six_plus_six_AcmsteeringV09_main_2lfrf/Data_input/BMS1" /begin SUB_GROUP S18_BMS1 /end SUB_GROUP /end GROUP
/begin GROUP S1_BMS1_2 "six_plus_six_AcmsteeringV09_main_2lfrf/Data_input/BMS1-2" /begin SUB_GROUP S19_BMS1 /end SUB_GROUP /end GROUP
/begin GROUP S1_BMS1_1 "six_plus_six_AcmsteeringV09_main_2lfrf/Data_input/BMS1_1" /begin SUB_GROUP S20_BMS1 /end SUB_GROUP /end GROUP
/begin GROUP S1_MCU0 "six_plus_six_AcmsteeringV09_main_2lfrf/Data_input/MCU0" /begin SUB_GROUP S35_MCU0 /end SUB_GROUP /end GROUP
/begin GROUP S1_MCU0_1 "six_plus_six_AcmsteeringV09_main_2lfrf/Data_input/MCU0_1" /begin SUB_GROUP S36_MCU0 /end SUB_GROUP /end GROUP
/begin GROUP S1_MCU0_2 "six_plus_six_AcmsteeringV09_main_2lfrf/Data_input/MCU0_2" /begin SUB_GROUP S37_MCU0 /end SUB_GROUP /end GROUP
/begin GROUP S1_MCU0_3 "six_plus_six_AcmsteeringV09_main_2lfrf/Data_input/MCU0_3" /begin SUB_GROUP S38_MCU0 /end SUB_GROUP /end GROUP
/begin GROUP S1_MCU0_4 "six_plus_six_AcmsteeringV09_main_2lfrf/Data_input/MCU0_4" /begin SUB_GROUP S39_MCU0 /end SUB_GROUP /end GROUP
/begin GROUP S1_MCU0_5 "six_plus_six_AcmsteeringV09_main_2lfrf/Data_input/MCU0_5" /begin SUB_GROUP S40_MCU0 /end SUB_GROUP /end GROUP
/begin GROUP S3_mode_control "six_plus_six_AcmsteeringV09_main_2lfrf/MainControl/mode_control" /begin SUB_GROUP S408_backward S408_forward /end SUB_GROUP /end GROUP
/begin GROUP S3_mode_switch "six_plus_six_AcmsteeringV09_main_2lfrf/MainControl/mode_switch" /begin REF_MEASUREMENT mode_dem_out /end REF_MEASUREMENT /end GROUP
/begin GROUP S18_BMS1 "six_plus_six_AcmsteeringV09_main_2lfrf/Data_input/BMS1/BMS1" /begin REF_MEASUREMENT BMS1_SOC /end REF_MEASUREMENT /end GROUP
/begin GROUP S19_BMS1 "six_plus_six_AcmsteeringV09_main_2lfrf/Data_input/BMS1-2/BMS1" /begin REF_MEASUREMENT BMS1_2SOC /end REF_MEASUREMENT /end GROUP
/begin GROUP S20_BMS1 "six_plus_six_AcmsteeringV09_main_2lfrf/Data_input/BMS1_1/BMS1" /begin REF_MEASUREMENT BMS1_1SOC /end REF_MEASUREMENT /end GROUP
/begin GROUP S35_MCU0 "six_plus_six_AcmsteeringV09_main_2lfrf/Data_input/MCU0/MCU0" /begin REF_MEASUREMENT MCU0_SpeedFdk /end REF_MEASUREMENT /end GROUP
/begin GROUP S36_MCU0 "six_plus_six_AcmsteeringV09_main_2lfrf/Data_input/MCU0_1/MCU0" /begin REF_MEASUREMENT MCU0_1SpeedFdk /end REF_MEASUREMENT /end GROUP
/begin GROUP S37_MCU0 "six_plus_six_AcmsteeringV09_main_2lfrf/Data_input/MCU0_2/MCU0" /begin REF_MEASUREMENT MCU0_2SpeedFdk /end REF_MEASUREMENT /end GROUP
/begin GROUP S38_MCU0 "six_plus_six_AcmsteeringV09_main_2lfrf/Data_input/MCU0_3/MCU0" /begin REF_MEASUREMENT MCU0_3SpeedFdk /end REF_MEASUREMENT /end GROUP
/begin GROUP S39_MCU0 "six_plus_six_AcmsteeringV09_main_2lfrf/Data_input/MCU0_4/MCU0" /begin REF_MEASUREMENT MCU0_4SpeedFdk /end REF_MEASUREMENT /end GROUP
/begin GROUP S40_MCU0 "six_plus_six_AcmsteeringV09_main_2lfrf/Data_input/MCU0_5/MCU0" /begin REF_MEASUREMENT MCU0_5SpeedFdk /end REF_MEASUREMENT /end GROUP
/begin GROUP S408_backward "six_plus_six_AcmsteeringV09_main_2lfrf/MainControl/mode_control/backward" /begin SUB_GROUP S411_backward /end SUB_GROUP /end GROUP
/begin GROUP S408_forward "six_plus_six_AcmsteeringV09_main_2lfrf/MainControl/mode_control/forward" /begin SUB_GROUP S414_forward /end SUB_GROUP /end GROUP
/begin GROUP S411_backward "six_plus_six_AcmsteeringV09_main_2lfrf/MainControl/mode_control/backward/backward" /begin SUB_GROUP S423_Drive /end SUB_GROUP /end GROUP
/begin GROUP S414_forward "six_plus_six_AcmsteeringV09_main_2lfrf/MainControl/mode_control/forward/forward" /begin SUB_GROUP S878_Drive /end SUB_GROUP /end GROUP
/begin GROUP S423_Drive "six_plus_six_AcmsteeringV09_main_2lfrf/MainControl/mode_control/backward/backward/Drive" /begin SUB_GROUP S425_____ S425_______TCS S425________ S425___________ /end SUB_GROUP /begin REF_CHARACTERISTIC ag_thr /end REF_CHARACTERISTIC /end GROUP
/begin GROUP S878_Drive "six_plus_six_AcmsteeringV09_main_2lfrf/MainControl/mode_control/forward/forward/Drive" /begin SUB_GROUP S880_____ S880_______TCS S880________ S880___________ /end SUB_GROUP /begin REF_CHARACTERISTIC ag_thr /end REF_CHARACTERISTIC /end GROUP
/begin GROUP S425_____ "six_plus_six_AcmsteeringV09_main_2lfrf/MainControl/mode_control/backward/backward/Drive/容错控制" /begin REF_CHARACTERISTIC guzhang_lm guzhang_lr guzhang_rm guzhang_rr /end REF_CHARACTERISTIC /end GROUP
/begin GROUP S425___________ "six_plus_six_AcmsteeringV09_main_2lfrf/MainControl/mode_control/backward/backward/Drive/目标直驶力矩确定模块" /begin REF_CHARACTERISTIC ag_thr /end REF_CHARACTERISTIC /end GROUP
/begin GROUP S425________ "six_plus_six_AcmsteeringV09_main_2lfrf/MainControl/mode_control/backward/backward/Drive/车辆稳定性控制" /begin REF_CHARACTERISTIC ESP_switch ag_thr kd1 ki1 kp1 /end REF_CHARACTERISTIC /end GROUP
/begin GROUP S425_______TCS "six_plus_six_AcmsteeringV09_main_2lfrf/MainControl/mode_control/backward/backward/Drive/驱动防滑控制TCS" /begin SUB_GROUP S576___TCS /end SUB_GROUP /end GROUP
/begin GROUP S880_____ "six_plus_six_AcmsteeringV09_main_2lfrf/MainControl/mode_control/forward/forward/Drive/容错控制" /begin REF_CHARACTERISTIC guzhang_lm guzhang_lr guzhang_rm guzhang_rr /end REF_CHARACTERISTIC /end GROUP
/begin GROUP S880___________ "six_plus_six_AcmsteeringV09_main_2lfrf/MainControl/mode_control/forward/forward/Drive/目标直驶力矩确定模块" /begin REF_CHARACTERISTIC ag_thr /end REF_CHARACTERISTIC /end GROUP
/begin GROUP S880________ "six_plus_six_AcmsteeringV09_main_2lfrf/MainControl/mode_control/forward/forward/Drive/车辆稳定性控制" /begin REF_CHARACTERISTIC ESP_switch ag_thr kd1 ki1 kp1 /end REF_CHARACTERISTIC /begin REF_MEASUREMENT delta_Twending_dem /end REF_MEASUREMENT /end GROUP
/begin GROUP S880_______TCS "six_plus_six_AcmsteeringV09_main_2lfrf/MainControl/mode_control/forward/forward/Drive/驱动防滑控制TCS" /begin SUB_GROUP S1031___TCS /end SUB_GROUP /end GROUP
/begin GROUP S576___TCS "six_plus_six_AcmsteeringV09_main_2lfrf/MainControl/mode_control/backward/backward/Drive/驱动防滑控制TCS/直行TCS" /begin SUB_GROUP S704___ /end SUB_GROUP /end GROUP
/begin GROUP S1031___TCS "six_plus_six_AcmsteeringV09_main_2lfrf/MainControl/mode_control/forward/forward/Drive/驱动防滑控制TCS/直行TCS"
 /begin SUB_GROUP S1159_Subsystem S1159_Subsystem1 S1159_Subsystem2 S1159_Subsystem3 S1159_Subsystem4 S1159_Subsystem5 S1159___ /end SUB_GROUP
/end GROUP
/begin GROUP S704___ "six_plus_six_AcmsteeringV09_main_2lfrf/MainControl/mode_control/backward/backward/Drive/驱动防滑控制TCS/直行TCS/直行" /begin REF_CHARACTERISTIC TCS_switch /end REF_CHARACTERISTIC /end GROUP
/begin GROUP S1159_Subsystem "six_plus_six_AcmsteeringV09_main_2lfrf/MainControl/mode_control/forward/forward/Drive/驱动防滑控制TCS/直行TCS/Subsystem" /begin REF_MEASUREMENT s_act_lf /end REF_MEASUREMENT /end GROUP
/begin GROUP S1159_Subsystem1 "six_plus_six_AcmsteeringV09_main_2lfrf/MainControl/mode_control/forward/forward/Drive/驱动防滑控制TCS/直行TCS/Subsystem1" /begin REF_MEASUREMENT s_act_lm /end REF_MEASUREMENT /end GROUP
/begin GROUP S1159_Subsystem2 "six_plus_six_AcmsteeringV09_main_2lfrf/MainControl/mode_control/forward/forward/Drive/驱动防滑控制TCS/直行TCS/Subsystem2" /begin REF_MEASUREMENT s_act_lr /end REF_MEASUREMENT /end GROUP
/begin GROUP S1159_Subsystem3 "six_plus_six_AcmsteeringV09_main_2lfrf/MainControl/mode_control/forward/forward/Drive/驱动防滑控制TCS/直行TCS/Subsystem3" /begin REF_MEASUREMENT s_act_rf /end REF_MEASUREMENT /end GROUP
/begin GROUP S1159_Subsystem4 "six_plus_six_AcmsteeringV09_main_2lfrf/MainControl/mode_control/forward/forward/Drive/驱动防滑控制TCS/直行TCS/Subsystem4" /begin REF_MEASUREMENT s_act_rm /end REF_MEASUREMENT /end GROUP
/begin GROUP S1159_Subsystem5 "six_plus_six_AcmsteeringV09_main_2lfrf/MainControl/mode_control/forward/forward/Drive/驱动防滑控制TCS/直行TCS/Subsystem5" /begin REF_MEASUREMENT s_act_rr /end REF_MEASUREMENT /end GROUP
/begin GROUP S1159___ "six_plus_six_AcmsteeringV09_main_2lfrf/MainControl/mode_control/forward/forward/Drive/驱动防滑控制TCS/直行TCS/直行" /begin SUB_GROUP S1168_Subsystem /end SUB_GROUP /begin REF_CHARACTERISTIC TCS_switch /end REF_CHARACTERISTIC
 /begin REF_MEASUREMENT TCS_mode flag_lf flag_lm flag_lr flag_rf flag_rm flag_rr trq_adjust_l_forward trq_adjust_r_forward trq_dem_l_forward trq_dem_r_forward trq_out_l_forward trq_out_lf_forward trq_out_lm_forward trq_out_lr_forward trq_out_r_forward trq_out_rf_forward trq_out_rm_forward trq_out_rr_forward /end REF_MEASUREMENT
/end GROUP
/begin GROUP S1168_Subsystem "six_plus_six_AcmsteeringV09_main_2lfrf/MainControl/mode_control/forward/forward/Drive/驱动防滑控制TCS/直行TCS/直行/Subsystem"
 /begin SUB_GROUP S1183_Subsystem S1183_Subsystem1 S1183_Subsystem2 S1183_Subsystem3 S1183_Subsystem4 S1183_Subsystem5 /end SUB_GROUP
/end GROUP
/begin GROUP S1183_Subsystem "six_plus_six_AcmsteeringV09_main_2lfrf/MainControl/mode_control/forward/forward/Drive/驱动防滑控制TCS/直行TCS/直行/Subsystem/Subsystem" /begin REF_MEASUREMENT trq_pid_lf_adjust /end REF_MEASUREMENT /end GROUP
/begin GROUP S1183_Subsystem1 "six_plus_six_AcmsteeringV09_main_2lfrf/MainControl/mode_control/forward/forward/Drive/驱动防滑控制TCS/直行TCS/直行/Subsystem/Subsystem1" /begin REF_MEASUREMENT trq_pid_lr_adjust /end REF_MEASUREMENT /end GROUP
/begin GROUP S1183_Subsystem2 "six_plus_six_AcmsteeringV09_main_2lfrf/MainControl/mode_control/forward/forward/Drive/驱动防滑控制TCS/直行TCS/直行/Subsystem/Subsystem2" /begin REF_MEASUREMENT trq_pid_rf_adjust /end REF_MEASUREMENT /end GROUP
/begin GROUP S1183_Subsystem3 "six_plus_six_AcmsteeringV09_main_2lfrf/MainControl/mode_control/forward/forward/Drive/驱动防滑控制TCS/直行TCS/直行/Subsystem/Subsystem3" /begin REF_MEASUREMENT trq_pid_rr_adjust /end REF_MEASUREMENT /end GROUP
/begin GROUP S1183_Subsystem4 "six_plus_six_AcmsteeringV09_main_2lfrf/MainControl/mode_control/forward/forward/Drive/驱动防滑控制TCS/直行TCS/直行/Subsystem/Subsystem4" /begin REF_MEASUREMENT trq_pid_lm_adjust /end REF_MEASUREMENT /end GROUP
/begin GROUP S1183_Subsystem5 "six_plus_six_AcmsteeringV09_main_2lfrf/MainControl/mode_control/forward/forward/Drive/驱动防滑控制TCS/直行TCS/直行/Subsystem/Subsystem5" /begin REF_MEASUREMENT trq_pid_rm_adjust /end REF_MEASUREMENT /end GROUP
/end MODULE
/end PROJECT
/* (add any file trailer comments here) */
/* EOF six_plus_six_AcmsteeringV09_main_2lfrf.a2l */
